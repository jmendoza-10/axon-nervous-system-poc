## esp32/csi_passive/main/Kconfig.projbuild
```kconfig
menu "CSI Passive Configuration"

    config CSI_ANCHOR_MAC
        string "Anchor AP BSSID (MAC address)"
        default "00:00:00:00:00:00"
        help
            MAC address of the anchor AP whose frames will be used for CSI.
            Format: xx:xx:xx:xx:xx:xx (lowercase hex). Only frames from this
            source MAC are forwarded to the output; all others are discarded.
            Set this to the BSSID of the home AP in the monitored room.

    config CSI_CHANNEL
        int "WiFi channel to monitor"
        default 6
        range 1 13
        help
            802.11 2.4 GHz channel to lock to. Must match the channel your
            anchor AP broadcasts on. Check your router settings or use a
            WiFi scanner to confirm.

    config CSI_UDP_TARGET_IP
        string "UDP target IP (Raspberry Pi)"
        default "0.0.0.0"
        help
            IP address of the Raspberry Pi room node. 0.0.0.0 means unset.
            Set it in menuconfig. Phase 2a prints JSON on UART and does not
            open a UDP socket; this value is the address for a later UDP path.

    config CSI_UDP_TARGET_PORT
        int "UDP target port"
        default 5500
        range 1024 65535
        help
            UDP port on the Raspberry Pi listening for CSI JSON data.

endmenu
```

## esp32/csi_rx/main/Kconfig.projbuild
```kconfig
menu "CSI RX Configuration"

    config CSI_RX_SSID
        string "CSI TX AP SSID to connect to"
        default "YOUR_SSID"
        help
            SSID of the Wi-Fi network the receiver joins. Replace YOUR_SSID
            via menuconfig (or scripts/flash_esp32.sh --wifi-ssid) before flashing.

    config CSI_RX_PASSWORD
        string "CSI TX AP Password"
        default "YOUR_PASSWORD"
        help
            Passphrase for that Wi-Fi network. Replace YOUR_PASSWORD via
            menuconfig (or scripts/flash_esp32.sh --wifi-pass) before flashing.

    config CSI_UDP_TARGET_IP
        string "UDP target IP (Raspberry Pi)"
        default "0.0.0.0"
        help
            IP address of the Raspberry Pi room node that receives CSI JSON.
            0.0.0.0 means unset. Set the Pi's address in menuconfig, or pass
            --pi-host to scripts/flash_esp32.sh.

    config CSI_UDP_TARGET_PORT
        int "UDP target port"
        default 5500
        range 1024 65535
        help
            UDP port on the Raspberry Pi listening for CSI JSON data.

endmenu
```

## esp32/csi_tx/main/Kconfig.projbuild
```kconfig
menu "CSI TX Configuration"

    config CSI_TX_SSID
        string "WiFi SSID for CSI AP"
        default "YOUR_SSID"
        help
            SSID of the Wi-Fi network the transmitter joins. Replace YOUR_SSID
            via menuconfig (or scripts/flash_esp32.sh --wifi-ssid) before flashing.

    config CSI_TX_PASSWORD
        string "WiFi Password"
        default "YOUR_PASSWORD"
        help
            Passphrase for that Wi-Fi network. Replace YOUR_PASSWORD via
            menuconfig (or scripts/flash_esp32.sh --wifi-pass) before flashing.
            Leave empty for an open network.


endmenu
```
